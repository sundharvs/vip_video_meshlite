## main/Kconfig.projbuild
```kconfig
menu "VIP Video Streaming Config"

config ROUTER_SSID
    string "Router SSID"
        default "sundharvs-laptop"
        help
            Router SSID.

config ROUTER_PASSWORD
    string "Router password"
        default "password"
        help
            Router password.

config GS_IP
    string "Ground Station Server IP address"
        default "192.168.0.1"
        help
            Ground Station Server IP address.

config GS_PORT
    int "Ground Station port"
        default "8070"
        help
            Ground station port.

config DRONE_IP
    string "Drone server IP address"
        default "192.168.0.1"
        help
            Drone Server IP address.

config DRONE_PORT
    int "Droneer port"
        default "8070"
        help
            Drone port.
            
endmenu
```
